#include <TimeLib.h>

#define CS328 2
#define nRD 3
#define Z80nRESET 4
#define RESET8255 5
#define nWAITrelease 6
#define ZA0 7
#define nWR 10
#define Z80CLK 11
#define ZA1 12
#define RAMCEINHIBIT 13

const byte intmini[] PROGMEM = {
0xf3, 0xc3, 0xb2, 0x00, 0x00, 0x00, 0x00, 0x00, 0xc3, 0xa2, 0x00, 0x00, 0x00, 0x00, 0x00, 0x00,
0xc3, 0x74, 0x00, 0x00, 0x00, 0x00, 0x00, 0x00, 0xc3, 0xa5, 0x00, 0x00, 0x00, 0x00, 0x00, 0x00,
0x00, 0x00, 0x00, 0x00, 0x00, 0x00, 0x00, 0x00, 0x00, 0x00, 0x00, 0x00, 0x00, 0x00, 0x00, 0x00,
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0x72, 0x74, 0x20, 0x28, 0x43, 0x20, 0x6f, 0x72, 0x20, 0x57, 0x29, 0x3f, 0x20,

};

const byte basic4[] PROGMEM = {
0xc3, 0x56, 0x01, 0xc3, 0xf4, 0x01, 0xdd, 0x21, 0x00, 0x00, 0xc3, 0x61, 0x01, 0x0c, 0x0a, 0x82,
0x11, 0x21, 0x45, 0x20, 0xf9, 0xc3, 0xa1, 0x1d, 0x11, 0x33, 0x04, 0x06, 0x63, 0x21, 0x45, 0x20,
0x1a, 0x77, 0x23, 0x13, 0x05, 0xc2, 0x70, 0x01, 0xf9, 0xcd, 0x34, 0x06, 0xcd, 0x02, 0x0c, 0x32,
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0x00, 0xc9, 0xcd, 0xdb, 0x07, 0xc3, 0x02,

};

const byte monitor4[] PROGMEM = {
  // 0x3e, 0x90, 0xd3, 0x83, 0x3e, 0xff, 0xd3, 0x82, 0x3e, 0x00, 0xd3, 0x82, 0xc3, 0x00, 0x00
  // 0x3e, 0x90, 0xd3, 0x83, 0x3e, 0x00, 0xd3, 0x82, 0xdb, 0x80, 0xd3, 0x81, 0xc3, 0x00, 0x00

  0x31, 0x3e, 0x00, 0x3e, 0x3e, 0xd3, 0x01, 0x21, 0x3e, 0x00, 0x36, 0x10, 0xdb, 0x01, 0x77, 0xfe,
  0x10, 0x28, 0x03, 0x23, 0x18, 0xf4, 0x21, 0x3e, 0x00, 0x7e, 0x3e, 0x45, 0xd3, 0x01, 0x3e, 0x52,
  0xd3, 0x01, 0xd3, 0x01, 0x3e, 0x10, 0xd3, 0x01, 0x18, 0xd9, 0x00, 0x00, 0x00, 0x00, 0x00, 0x00,
  0x00, 0x00, 0x00, 0x00, 0x00, 0x00, 0x00, 0x00, 0x00, 0x00, 0x00, 0x00, 0x00, 0x00,

  // 0x3e, 0x31, 0xd3, 0x01, 0x3e, 0x32, 0xd3, 0x01, 0x3e, 0x0d, 0xd3, 0x01,
  // 0xdb, 0x01, 0x00, 0x00, 0x00, 0xd3, 0x01, 0xc3, 0x0c, 0x00, 0x00, 0xc3, 0x0c, 0x00

  // 0xc3, 0x00, 0x20
};
// tiny BASIC
const byte basic[] PROGMEM = {

};

// simple-monitor
const byte simple_monitor[] PROGMEM = {
0x31, 0x17, 0x01, 0x3e, 0x3e, 0xd3, 0x01, 0x21, 0x17, 0x01, 0x36, 0x0a, 0xdb, 0x01, 0x77, 0xd3,
0x01, 0xfe, 0x0d, 0x28, 0x03, 0x23, 0x18, 0xf2, 0x21, 0x17, 0x01, 0x7e, 0xfe, 0x63, 0x28, 0x28,
0xfe, 0x43, 0x28, 0x24, 0xfe, 0x64, 0x28, 0x2c, 0xfe, 0x44, 0x28, 0x28, 0xfe, 0x69, 0x28, 0x53,
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0x00, 0x00, 0x00, 0x00, 0x00, 0x00,

};


const byte pi_calcu[] PROGMEM = {
0xf3, 0xc3, 0xd2, 0x01, 0x08, 0x3e, 0x01, 0xd3, 0x00, 0x08, 0xd3, 0x01, 0xc9, 0x7e, 0x23, 0xb7,
0xc8, 0xcd, 0x04, 0x00, 0x18, 0xf7, 0x11, 0xe8, 0x03, 0xcd, 0x2b, 0x00, 0x11, 0x64, 0x00, 0xcd,
0x2b, 0x00, 0x11, 0x0a, 0x00, 0xcd, 0x2b, 0x00, 0x7d, 0x18, 0x08, 0x3e, 0xff, 0x3c, 0xed, 0x52,
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0x20, 0x20, 0x00, 0x3a, 0x20,

};

// abc-80
const byte monitor[] PROGMEM = {
0x06, 0x00, 0x10, 0xfe, 0xc3, 0x70, 0x00, 0x00, 0x00, 0x00, 0x00, 0x00, 0x00, 0x00, 0x00, 0x00,
0x00, 0x00, 0x00, 0x00, 0x00, 0x00, 0x00, 0x00, 0x00, 0x00, 0x00, 0x00, 0x00, 0x00, 0x00, 0x00,
0x00, 0x00, 0x00, 0x00, 0x00, 0x00, 0x00, 0x00, 0x00, 0x00, 0x00, 0x00, 0x00, 0x00, 0x00, 0x00,
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0xa9, 0x07, 0xb6, 0x8a, 0x83, 0xa2, 0x32, 0x02, 0xc0,

};

#define SETDATABUSOUT(DATA) \
  PORTC = (PORTC & ~0x3f) | ((byte)DATA & 0x3f); \
  PORTB = (PORTB &= ~0x03) | (((byte)DATA & 0xc0) >> 6); \
  DDRC |= 0x3f; \
  DDRB |= 0x03
#define SETDATABUSIN \
  DDRC &= ~0x3f; \
  DDRB &= ~0x03; \
  PORTC |= 0x3f; \
  PORTB |= 0x03
#define Z80CLKSTROBE \
  digitalWrite(Z80CLK, HIGH); \
  digitalWrite(Z80CLK, LOW)

void resetZ80() {
  digitalWrite(nWAITrelease, LOW);
  digitalWrite(Z80nRESET, LOW);
  Z80CLKSTROBE;
  Z80CLKSTROBE;
  Z80CLKSTROBE;
  digitalWrite(Z80nRESET, HIGH);
  digitalWrite(nWAITrelease, HIGH);

  Z80CLKSTROBE;
  Z80CLKSTROBE;
}
void loadHL(word value) {
  Z80CLKSTROBE;
  digitalWrite(RAMCEINHIBIT, HIGH);  // disable RAM
  SETDATABUSOUT(0x21);               // LD HL, n
  Z80CLKSTROBE;
  Z80CLKSTROBE;
  SETDATABUSIN;
  Z80CLKSTROBE;
  Z80CLKSTROBE;

  SETDATABUSOUT(lowByte(value));
  Z80CLKSTROBE;
  Z80CLKSTROBE;
  Z80CLKSTROBE;
  SETDATABUSOUT(highByte(value));
  Z80CLKSTROBE;
  Z80CLKSTROBE;
  digitalWrite(RAMCEINHIBIT, LOW);  // enable RAM
}
void loadByteToRAMandIncHL(byte value) {
  Z80CLKSTROBE;
  digitalWrite(RAMCEINHIBIT, HIGH);  // disable RAM
  SETDATABUSOUT(0x36);               // LD(HL), n
  Z80CLKSTROBE;
  Z80CLKSTROBE;
  SETDATABUSIN;
  Z80CLKSTROBE;
  Z80CLKSTROBE;

  SETDATABUSOUT(value);
  Z80CLKSTROBE;
  Z80CLKSTROBE;
  SETDATABUSIN;
  digitalWrite(RAMCEINHIBIT, LOW);  // enable RAM
  Z80CLKSTROBE;
  Z80CLKSTROBE;
  Z80CLKSTROBE;

  Z80CLKSTROBE;
  digitalWrite(RAMCEINHIBIT, HIGH);  // disable RAM
  SETDATABUSOUT(0x23);               // INC HL
  Z80CLKSTROBE;
  Z80CLKSTROBE;
  SETDATABUSIN;
  digitalWrite(RAMCEINHIBIT, LOW);  // enable RAM
  Z80CLKSTROBE;
  Z80CLKSTROBE;
  Z80CLKSTROBE;
}

void setup() {  
  // while(1);
  //  put your setup code here, to run once:
  pinMode(A0, INPUT_PULLUP);
  pinMode(A1, INPUT_PULLUP);
  pinMode(A2, INPUT_PULLUP);
  pinMode(A3, INPUT_PULLUP);
  pinMode(A4, INPUT_PULLUP);
  pinMode(A5, INPUT_PULLUP);
  pinMode(8, INPUT_PULLUP);
  pinMode(9, INPUT_PULLUP);

  pinMode(ZA0, INPUT_PULLUP);
  digitalWrite(ZA0, HIGH);
  pinMode(ZA1, INPUT_PULLUP);
  digitalWrite(ZA1, HIGH);
  pinMode(Z80CLK, OUTPUT);
  digitalWrite(Z80CLK, LOW);
  pinMode(Z80nRESET, OUTPUT);
  digitalWrite(Z80nRESET, HIGH);
  pinMode(RESET8255, OUTPUT);
  digitalWrite(RESET8255, LOW);
  pinMode(nWAITrelease, OUTPUT);
  digitalWrite(nWAITrelease, LOW);
  digitalWrite(nWAITrelease, HIGH);
  pinMode(CS328, INPUT_PULLUP);  // digitalWrite(nIORQ, HIGH);
  pinMode(nWR, INPUT_PULLUP);    // digitalWrite(nWR, HIGH);
  pinMode(nRD, INPUT_PULLUP);    // digitalWrite(nRD, HIGH);
  pinMode(RAMCEINHIBIT, OUTPUT);
  digitalWrite(RAMCEINHIBIT, HIGH);

  // attachInterrupt(digitalPinToInterrupt(CS328), ioPROCESS, CHANGE);

  resetZ80();
  digitalWrite(RESET8255, HIGH);
  digitalWrite(RESET8255, LOW);

  Serial.begin(57600);
  Serial.println();
  Serial.print("arduino compile date/time: ");
  Serial.print(__DATE__);
  Serial.print(" / ");
  Serial.println(__TIME__);

  Serial.println("1. ABC-80");
  Serial.println("2. Calculate PI");
  Serial.println("3. simple monitor");
  Serial.println("4. BASIC");
  unsigned long waiting_time = millis();
  int incomingByte = 0;
  while(1){
    if((millis() - waiting_time) > 5000){
      incomingByte = '1';
      Serial.println();
    }
    if((millis() - waiting_time) % 1000 == 0){
      Serial.print(".");
      delay(1);
    }
    if(Serial.available() > 0){
      incomingByte = Serial.read();
      Serial.println();
    }
      if(incomingByte == '1'){
        Serial.println("Loading ABC-80...");
        loadHL(0x0000);
        for (word i = 0; i < sizeof(monitor); i++) {
          loadByteToRAMandIncHL(pgm_read_byte(monitor + i));
          // Serial.println();
        }
        break;
      }
      else if(incomingByte == '2'){
        Serial.println("Loading PI ...");
        loadHL(0x0000);
        for (word i = 0; i < sizeof(pi_calcu); i++) {
          loadByteToRAMandIncHL(pgm_read_byte(pi_calcu + i));
          // Serial.println();
        }
        break;
      }
      else if(incomingByte == '3'){
        Serial.println("Loading simple monitor...");
        loadHL(0x0000);
        for (word i = 0; i < sizeof(simple_monitor); i++) {
          loadByteToRAMandIncHL(pgm_read_byte(simple_monitor + i));
          // Serial.println();
        }
        break;
      }
      else if(incomingByte == '4'){
        Serial.println("Loading BASIC...");
        loadHL(0x0000);
        for (word i = 0; i < sizeof(intmini); i++) {
          loadByteToRAMandIncHL(pgm_read_byte(intmini + i));
          // Serial.println();
        }
        loadHL(0x0150);
        for (word i = 0; i < sizeof(basic4); i++) {
          loadByteToRAMandIncHL(pgm_read_byte(basic4 + i));
          // Serial.println();
        }
        break;
      }
    
  }
  // Serial.println(sizeof(monitor));
  // Serial.println(sizeof(pi_calcu));
  // Serial.println(sizeof(simple_monitor));
  // Serial.println(sizeof(basic4));
  delay(300);

  // resetZ80();

  digitalWrite(Z80nRESET, LOW);

  // TCCR2A = bit(COM2B1) | bit(WGM21) | bit(WGM20);
  // TCCR2B = bit(WGM22) | bit(CS20);
  // OCR2A = 13;
  // OCR2B = 1;

  // // pin 3 output
  // TCCR2A = _BV(COM2A1) | _BV(COM2B1) | _BV(WGM21) | _BV(WGM20);
  // TCCR2B = _BV(WGM22) | _BV(CS20);
  // OCR2A = 63;
  // OCR2B = 0;

  // // pin 11 output
  TCCR2A = _BV(COM2A0) | _BV(COM2B1) | _BV(WGM21) | _BV(WGM20);
  TCCR2B = _BV(WGM22) | _BV(CS20);
  // OCR2A = 7; // 999kHz
  //  OCR2A = 23; // 332kHz
  OCR2A = 1;

  OCR2B = 1;

  delay(1);

  digitalWrite(nWAITrelease, LOW);
  digitalWrite(nWAITrelease, HIGH);

  digitalWrite(Z80nRESET, HIGH);
}

// int Write328IOData = 0;
// int IO328ReadData = 0;
// void ioPROCESS()
// {

//   // PORTD &= ~(1L<<6);
//   // digitalWrite(nWAITrelease, LOW);

//   // (digitalRead(CS328) == LOW) &&
//   // if(digitalRead(CS328) == LOW){
//   if ((PIND & B00000100) == B00000000)
//   {

//     // if((digitalRead(nRD) == LOW)){
//     if ((PIND & B00001000) == B00000000)
//     {
//       IO328ReadData = 1;

//       // TCCR2A = _BV(COM2A0) | _BV(COM2B1) | _BV(WGM21) | _BV(WGM20);
//       // TCCR2B =  _BV(WGM22) | _BV(CS20);
//       // OCR2A = 30;
//       // OCR2B = 1;
//     }

//     // if((digitalRead(nWR) == LOW)){
//     if ((PINB & B00000100) == B00000000)
//     {
//       SETDATABUSIN;
//       Write328IOData = 1;
//     }
//   }
//   // if(digitalRead(CS328) == HIGH){
//   //   digitalWrite(nWAITrelease, LOW);
//   //   digitalWrite(nWAITrelease, HIGH);
//   //   // delay(2);
//   // }
// }

byte cmd_gettime = 0;


void loop() {
  // put your main code here, to run repeatedly:
  // delay(000);

  // digitalWrite(Z80CLK, HIGH); /*delay(000);*/ digitalWrite(Z80CLK, LOW);
  /*delay(000);*/
  // Serial.println();
  // CS328 and nWR
  if (((PIND & B00000100) == B00000000) && ((PINB & B00000100) == B00000000)) {

    // delay(1);
    int receive_char;
    // A0 == 0 A1 == 0
    if (((PIND & B10000000) == B00000000) && ((PINB & B00010000) == B00000000)) {
      delay(1);
      receive_char = (PINC & 0x3f | ((PINB & 0x03) << 6));
      if (receive_char == 0x84) {
        cmd_gettime = 1;
        // Serial.println("0x84");
      }
      // delay(1000);
      // digitalWrite(nWAITrelease, LOW);
      // stop timer
      TCCR2A = 0;
      TCCR2B = 0;
      Z80CLKSTROBE;
      PORTD = PORTD & ~B01000000;  // nWAIT release
      Z80CLKSTROBE;                // Tw
      Z80CLKSTROBE;                // T3

      // fetch cycle
      Z80CLKSTROBE;  // T1
      Z80CLKSTROBE;  // T2
      Z80CLKSTROBE;  // T3
      Z80CLKSTROBE;  // T4

      // while((PIND&B00000100) == B00000000);
      // while((PINB&B00000100) == B00000000);
      // digitalWrite(nWAITrelease, HIGH);
      PORTD = PORTD | B01000000;


      // delay(2);
      // restart timer
      TCCR2A = _BV(COM2A0) | _BV(COM2B1) | _BV(WGM21) | _BV(WGM20);
      TCCR2B = _BV(WGM22) | _BV(CS20);
    } // A0 == 0 A1 == 0
    // if(digitalRead(ZA0)==0 && digitalRead(ZA1)==0){
    // A0 == 1 A1 == 0
    else if (((PIND & B10000000) == B10000000) && ((PINB & B00010000) == B00000000)) {
      delay(1);
      receive_char = (PINC & 0x3f | ((PINB & 0x03) << 6));
      // Serial.print(receive_char, HEX); Serial.print(" ");


      Serial.write(receive_char);  // Serial.println();

      // delay(1000);
      // digitalWrite(nWAITrelease, LOW);
      // stop timer
      TCCR2A = 0;
      TCCR2B = 0;
      Z80CLKSTROBE;
      PORTD = PORTD & ~B01000000;  // nWAIT release
      Z80CLKSTROBE;                // Tw
      Z80CLKSTROBE;                // T3

      // fetch cycle
      Z80CLKSTROBE;  // T1
      Z80CLKSTROBE;  // T2
      Z80CLKSTROBE;  // T3
      Z80CLKSTROBE;  // T4

      // digitalWrite(nWAITrelease, HIGH);
      PORTD = PORTD | B01000000;


      // delay(2);
      // restart timer
      TCCR2A = _BV(COM2A0) | _BV(COM2B1) | _BV(WGM21) | _BV(WGM20);
      TCCR2B = _BV(WGM22) | _BV(CS20);
    } // A0 == 1 A1 == 0
    else
    {
      // delay(1);
      TCCR2A = 0;
      TCCR2B = 0;
      Z80CLKSTROBE;
      PORTD = PORTD & ~B01000000;  // nWAIT release
      Z80CLKSTROBE;                // Tw
      Z80CLKSTROBE;                // T3

      // fetch cycle
      Z80CLKSTROBE;  // T1
      Z80CLKSTROBE;  // T2
      Z80CLKSTROBE;  // T3
      Z80CLKSTROBE;  // T4

      PORTD = PORTD | B01000000;

      TCCR2A = _BV(COM2A0) | _BV(COM2B1) | _BV(WGM21) | _BV(WGM20);
      TCCR2B = _BV(WGM22) | _BV(CS20);

    }
  }  // IOWrite

  // CS328 and nRD
  if (((PIND & B00000100) == B00000000) && ((PIND & B00001000) == B00000000)) {

    // if(digitalRead(ZA0)==1 && digitalRead(ZA1)==0){

    // delayMicroseconds(10);
    // A0 == 0 A1 == 0
    if ((((PIND & B10000000) == B00000000) && ((PINB & B00010000) == B00000000)) && (cmd_gettime > 0)) {

        int dat;
        if (cmd_gettime == 1) {
          dat = second();
          cmd_gettime = 2;
        }
        else if (cmd_gettime == 2) {
          dat = minute();
          cmd_gettime = 3;
        }
        else if (cmd_gettime == 3) {
          dat = hour();
          cmd_gettime = 0;
        }

        TCCR2A = 0;
        TCCR2B = 0;
        Z80CLKSTROBE;
        PORTD = PORTD & ~B01000000;  // nWAIT release
        Z80CLKSTROBE;                // Tw
        SETDATABUSOUT((byte)dat);

        Z80CLKSTROBE;  // T3

        SETDATABUSIN;  // change databus direction

        // fetch cycle
        Z80CLKSTROBE;  // T1
        Z80CLKSTROBE;  // T2
        Z80CLKSTROBE;  // T3
        Z80CLKSTROBE;  // T4

        // digitalWrite(nWAITrelease, HIGH);
        PORTD = PORTD | B01000000;

        // restart timer
        TCCR2A = _BV(COM2A0) | _BV(COM2B1) | _BV(WGM21) | _BV(WGM20);
        TCCR2B = _BV(WGM22) | _BV(CS20);

    }
    // if(digitalRead(ZA0)==0 && digitalRead(ZA1)==0){
    // A0 == 1 A1 == 0
    else if (((PIND & B10000000) == B10000000) && ((PINB & B00010000) == B00000000)) {
      // incomingByte = 0xff;
      if (Serial.available() > 0) {
        int incomingByte = 0;

        // if (UCSR0A & _BV(RXC0)) {
        incomingByte = Serial.read();
        // incomingByte = UDR0 ;//
        // Serial.println(incomingByte, HEX);

        // stop timer
        TCCR2A = 0;
        TCCR2B = 0;
        Z80CLKSTROBE;
        PORTD = PORTD & ~B01000000;  // nWAIT release
        Z80CLKSTROBE;                // Tw
        SETDATABUSOUT(incomingByte);

        Z80CLKSTROBE;  // T3

        SETDATABUSIN;  // change databus direction

        // fetch cycle
        Z80CLKSTROBE;  // T1
        Z80CLKSTROBE;  // T2
        Z80CLKSTROBE;  // T3
        Z80CLKSTROBE;  // T4

        PORTD = PORTD | B01000000;

        // restart timer
        TCCR2A = _BV(COM2A0) | _BV(COM2B1) | _BV(WGM21) | _BV(WGM20);
        TCCR2B = _BV(WGM22) | _BV(CS20);
      }



    }  // A0 ==1 A1 == 0
    // A0 == 0 A1 == 1
    else if (((PIND & B10000000) == B00000000) && ((PINB & B00010000) == B00010000)) {
      int incomingByte = 0;
      if (Serial.available() > 0) {
        incomingByte = 0xff;
      }else{
        incomingByte = 0x00;
      }
        // stop timer
        TCCR2A = 0;
        TCCR2B = 0;
        Z80CLKSTROBE;
        PORTD = PORTD & ~B01000000;  // nWAIT release
        Z80CLKSTROBE;                // Tw
        SETDATABUSOUT(incomingByte);

        Z80CLKSTROBE;  // T3

        SETDATABUSIN;  // change databus direction

        // fetch cycle
        Z80CLKSTROBE;  // T1
        Z80CLKSTROBE;  // T2
        Z80CLKSTROBE;  // T3
        Z80CLKSTROBE;  // T4

        PORTD = PORTD | B01000000;

        // restart timer
        TCCR2A = _BV(COM2A0) | _BV(COM2B1) | _BV(WGM21) | _BV(WGM20);
        TCCR2B = _BV(WGM22) | _BV(CS20);            
    } // A0 == 0 A1 == 1
    else{
        // stop timer
        TCCR2A = 0;
        TCCR2B = 0;
        Z80CLKSTROBE;
        PORTD = PORTD & ~B01000000;  // nWAIT release
        Z80CLKSTROBE;                // Tw


        Z80CLKSTROBE;  // T3

        SETDATABUSIN;  // change databus direction

        // fetch cycle
        Z80CLKSTROBE;  // T1
        Z80CLKSTROBE;  // T2
        Z80CLKSTROBE;  // T3
        Z80CLKSTROBE;  // T4

        PORTD = PORTD | B01000000;

        // restart timer
        TCCR2A = _BV(COM2A0) | _BV(COM2B1) | _BV(WGM21) | _BV(WGM20);
        TCCR2B = _BV(WGM22) | _BV(CS20);            

    }
  }    // IORead
}
